## target/configs/d21x_demo128-nand_rt-thread_usb_h264_display_defconfig
```kconfig
CONFIG_PRJ_DEFCONFIG_FILENAME="d21x_demo128-nand_rt-thread_usb_h264_display_defconfig"
CONFIG_PRJ_CHIP="d21x"
CONFIG_PRJ_BOARD="demo128-nand"
CONFIG_PRJ_KERNEL="rt-thread"
CONFIG_PRJ_APP="usb_h264_display"
CONFIG_AIC_USING_UART0=y
CONFIG_AIC_USING_USB0=y
# CONFIG_AIC_USING_USB1 is not set
CONFIG_AIC_USING_QSPI0=y
CONFIG_AIC_QSPI0_DEVICE_SPINAND=y
CONFIG_AIC_DISP_LVDS=y
CONFIG_AICFB_RGB565=y
CONFIG_AIC_PAN_DISPLAY=y
CONFIG_AIC_USING_GE=y
CONFIG_AIC_USING_VE=y
CONFIG_AIC_PANEL_ENABLE_GPIO="PC.7"
CONFIG_AIC_USING_DMA=y
CONFIG_AIC_DRAM_CMA_SIZE=0x2000000
CONFIG_AIC_INTERRUPTSTACK_SIZE=4096
CONFIG_IDLE_THREAD_STACK_SIZE=2048
# CONFIG_RT_USING_TIMER_SOFT is not set
# CONFIG_RT_KSERVICE_USING_STDLIB is not set
# CONFIG_RT_KPRINTF_USING_LONGLONG is not set
# CONFIG_RT_DEBUG is not set
CONFIG_RT_MEMHEAP_BSET_MODE=y
CONFIG_RT_USING_MEMHEAP_AS_HEAP=y
# CONFIG_RT_USING_MEMHEAP_AUTO_BINDING is not set
CONFIG_RT_USING_DEVICE_OPS=y
CONFIG_RT_CONSOLE_DEVICE_NAME="uart0"
CONFIG_RT_MAIN_THREAD_STACK_SIZE=4096
CONFIG_FINSH_USING_WORD_OPERATION=y
CONFIG_FINSH_USING_FUNC_EXT=y
CONFIG_RT_USING_ULOG=y
CONFIG_ULOG_OUTPUT_LVL_I=y
CONFIG_ULOG_TIME_USING_TIMESTAMP=y
CONFIG_ULOG_USING_FILTER=y
CONFIG_LPKG_USING_CHERRYUSB=y
CONFIG_LPKG_CHERRYUSB_DEVICE=y
CONFIG_LPKG_CHERRYUSB_DEVICE_WINUSB_SINGLE=y
CONFIG_LPKG_MPP=y
CONFIG_AIC_MPP_H264_DEC_ENABLE=y
```
